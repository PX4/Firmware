## src/examples/matlab_csv_serial/Kconfig
```kconfig
menuconfig EXAMPLES_MATLAB_CSV_SERIAL
	bool "matlab_csv_serial"
	default n
	---help---
		Enable support for matlab_csv_serial
```

## src/examples/px4_mavlink_debug/Kconfig
```kconfig
menuconfig EXAMPLES_PX4_MAVLINK_DEBUG
	bool "px4_mavlink_debug"
	default n
	---help---
		Enable support for px4_mavlink_debug
```

## src/examples/px4_simple_app/Kconfig
```kconfig
menuconfig EXAMPLES_PX4_SIMPLE_APP
	bool "px4_simple_app"
	default n
	---help---
		Enable support for px4_simple_app
```

## src/examples/rover_steering_control/Kconfig
```kconfig
menuconfig EXAMPLES_ROVER_STEERING_CONTROL
	bool "rover_steering_control"
	default n
	---help---
		Enable support for rover_steering_control
```

## src/examples/uuv_example_app/Kconfig
```kconfig
menuconfig EXAMPLES_UUV_EXAMPLE_APP
	bool "uuv_example_app"
	default n
	---help---
		Enable support for uuv_example_app
```

## src/examples/work_item/Kconfig
```kconfig
menuconfig EXAMPLES_WORK_ITEM
	bool "work_item"
	default n
	---help---
		Enable support for work_item
```

## src/modules/airship_att_control/Kconfig
```kconfig
menuconfig MODULES_AIRSHIP_ATT_CONTROL
	bool "airship_att_control"
	default n
	---help---
		Enable support for airship_att_control
```

## src/modules/airspeed_selector/Kconfig
```kconfig
menuconfig MODULES_AIRSPEED_SELECTOR
	bool "airspeed_selector"
	default n
	---help---
		Enable support for airspeed_selector
```

## src/modules/angular_velocity_controller/Kconfig
```kconfig
menuconfig MODULES_ANGULAR_VELOCITY_CONTROLLER
	bool "angular_velocity_controller"
	default n
	---help---
		Enable support for angular_velocity_controller
```

## src/modules/attitude_estimator_q/Kconfig
```kconfig
menuconfig MODULES_ATTITUDE_ESTIMATOR_Q
	bool "attitude_estimator_q"
	default n
	---help---
		Enable support for attitude_estimator_q
```

## src/modules/battery_status/Kconfig
```kconfig
menuconfig MODULES_BATTERY_STATUS
	bool "battery_status"
	default n
	---help---
		Enable support for battery_status
```

## src/modules/camera_feedback/Kconfig
```kconfig
menuconfig MODULES_CAMERA_FEEDBACK
	bool "camera_feedback"
	default n
	---help---
		Enable support for camera_feedback
```

## src/modules/commander/Kconfig
```kconfig
menuconfig MODULES_COMMANDER
	bool "commander"
	default n
	---help---
		Enable support for commander
```

## src/modules/control_allocator/Kconfig
```kconfig
menuconfig MODULES_CONTROL_ALLOCATOR
	bool "control_allocator"
	default n
	---help---
		Enable support for control_allocator
```

## src/modules/dataman/Kconfig
```kconfig
menuconfig MODULES_DATAMAN
	bool "dataman"
	default n
	---help---
		Enable support for dataman
```

## src/modules/ekf2/Kconfig
```kconfig
menuconfig MODULES_EKF2
	bool "ekf2"
	default n
	---help---
		Enable support for ekf2
```

## src/modules/esc_battery/Kconfig
```kconfig
menuconfig MODULES_ESC_BATTERY
	bool "esc_battery"
	default n
	---help---
		Enable support for esc_battery
```

## src/modules/events/Kconfig
```kconfig
menuconfig MODULES_EVENTS
	bool "events"
	default n
	---help---
		Enable support for events
```

## src/modules/flight_mode_manager/Kconfig
```kconfig
menuconfig MODULES_FLIGHT_MODE_MANAGER
	bool "flight_mode_manager"
	default n
	---help---
		Enable support for flight_mode_manager
```

## src/modules/fw_att_control/Kconfig
```kconfig
menuconfig MODULES_FW_ATT_CONTROL
	bool "fw_att_control"
	default n
	---help---
		Enable support for fw_att_control
```

## src/modules/fw_pos_control_l1/Kconfig
```kconfig
menuconfig MODULES_FW_POS_CONTROL_L1
	bool "fw_pos_control_l1"
	default n
	---help---
		Enable support for fw_pos_control_l1
```

## src/modules/gyro_calibration/Kconfig
```kconfig
menuconfig MODULES_GYRO_CALIBRATION
	bool "gyro_calibration"
	default n
	---help---
		Enable support for gyro_calibration
```

## src/modules/gyro_fft/Kconfig
```kconfig
menuconfig MODULES_GYRO_FFT
	bool "gyro_fft"
	default n
	---help---
		Enable support for gyro_fft
```

## src/modules/land_detector/Kconfig
```kconfig
menuconfig MODULES_LAND_DETECTOR
	bool "land_detector"
	default n
	---help---
		Enable support for land_detector
```
