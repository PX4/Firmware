## src/systemcmds/dmesg/Kconfig
```kconfig
menuconfig SYSTEMCMDS_DMESG
	bool "dmesg"
	default n
	---help---
		Enable support for dmesg
```

## src/systemcmds/dumpfile/Kconfig
```kconfig
menuconfig SYSTEMCMDS_DUMPFILE
	bool "dumpfile"
	default n
	---help---
		Enable support for dumpfile
```

## src/systemcmds/dyn/Kconfig
```kconfig
menuconfig SYSTEMCMDS_DYN
	bool "dyn"
	default n
	---help---
		Enable support for dyn
```

## src/systemcmds/esc_calib/Kconfig
```kconfig
menuconfig SYSTEMCMDS_ESC_CALIB
	bool "esc_calib"
	default n
	---help---
		Enable support for esc_calib
```

## src/systemcmds/failure/Kconfig
```kconfig
menuconfig SYSTEMCMDS_FAILURE
	bool "failure"
	default n
	---help---
		Enable support for failure
```

## src/systemcmds/gpio/Kconfig
```kconfig
menuconfig SYSTEMCMDS_GPIO
	bool "gpio"
	default n
	---help---
		Enable support for gpio
```

## src/systemcmds/hardfault_log/Kconfig
```kconfig
menuconfig SYSTEMCMDS_HARDFAULT_LOG
	bool "hardfault_log"
	default n
	---help---
		Enable support for hardfault_log
```

## src/systemcmds/i2cdetect/Kconfig
```kconfig
menuconfig SYSTEMCMDS_I2CDETECT
	bool "i2cdetect"
	default n
	---help---
		Enable support for i2cdetect
```

## src/systemcmds/led_control/Kconfig
```kconfig
menuconfig SYSTEMCMDS_LED_CONTROL
	bool "led_control"
	default n
	---help---
		Enable support for led_control
```

## src/systemcmds/mft/Kconfig
```kconfig
menuconfig SYSTEMCMDS_MFT
	bool "mft"
	default n
	---help---
		Enable support for mft
```

## src/systemcmds/mixer/Kconfig
```kconfig
menuconfig SYSTEMCMDS_MIXER
	bool "mixer"
	default n
	---help---
		Enable support for mixer
```

## src/systemcmds/motor_ramp/Kconfig
```kconfig
menuconfig SYSTEMCMDS_MOTOR_RAMP
	bool "motor_ramp"
	default n
	---help---
		Enable support for motor_ramp
```

## src/systemcmds/motor_test/Kconfig
```kconfig
menuconfig SYSTEMCMDS_MOTOR_TEST
	bool "motor_test"
	default n
	---help---
		Enable support for motor_test
```

## src/systemcmds/mtd/Kconfig
```kconfig
menuconfig SYSTEMCMDS_MTD
	bool "mtd"
	default n
	---help---
		Enable support for mtd
```

## src/systemcmds/netman/Kconfig
```kconfig
menuconfig SYSTEMCMDS_NETMAN
	bool "netman"
	default n
	---help---
		Enable support for netman
```

## src/systemcmds/nshterm/Kconfig
```kconfig
menuconfig SYSTEMCMDS_NSHTERM
	bool "nshterm"
	default n
	---help---
		Enable support for nshterm
```

## src/systemcmds/param/Kconfig
```kconfig
menuconfig SYSTEMCMDS_PARAM
	bool "param"
	default n
	---help---
		Enable support for param
```

## src/systemcmds/perf/Kconfig
```kconfig
menuconfig SYSTEMCMDS_PERF
	bool "perf"
	default n
	---help---
		Enable support for perf
```

## src/systemcmds/pwm/Kconfig
```kconfig
menuconfig SYSTEMCMDS_PWM
	bool "pwm"
	default n
	---help---
		Enable support for pwm
```

## src/systemcmds/reboot/Kconfig
```kconfig
menuconfig SYSTEMCMDS_REBOOT
	bool "reboot"
	default n
	---help---
		Enable support for reboot
```

## src/systemcmds/reflect/Kconfig
```kconfig
menuconfig SYSTEMCMDS_REFLECT
	bool "reflect"
	default n
	---help---
		Enable support for reflect
```

## src/systemcmds/sd_bench/Kconfig
```kconfig
menuconfig SYSTEMCMDS_SD_BENCH
	bool "sd_bench"
	default n
	---help---
		Enable support for sd_bench
```

## src/systemcmds/serial_test/Kconfig
```kconfig
menuconfig SYSTEMCMDS_SERIAL_TEST
	bool "serial_test"
	default n
	---help---
		Enable support for serial_test
```

## src/systemcmds/shutdown/Kconfig
```kconfig
menuconfig SYSTEMCMDS_SHUTDOWN
	bool "shutdown"
	default n
	---help---
		Enable support for shutdown
```

## src/systemcmds/system_time/Kconfig
```kconfig
menuconfig SYSTEMCMDS_SYSTEM_TIME
	bool "system_time"
	default n
	---help---
		Enable support for system_time
```
