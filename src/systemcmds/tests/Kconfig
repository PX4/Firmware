## src/systemcmds/tests/Kconfig
```kconfig
menuconfig SYSTEMCMDS_TESTS
	bool "tests"
	default n
	---help---
		Enable support for tests
```

## src/systemcmds/top/Kconfig
```kconfig
menuconfig SYSTEMCMDS_TOP
	bool "top"
	default n
	---help---
		Enable support for top
```

## src/systemcmds/topic_listener/Kconfig
```kconfig
menuconfig SYSTEMCMDS_TOPIC_LISTENER
	bool "topic_listener"
	default n
	---help---
		Enable support for topic_listener
```

## src/systemcmds/tune_control/Kconfig
```kconfig
menuconfig SYSTEMCMDS_TUNE_CONTROL
	bool "tune_control"
	default n
	---help---
		Enable support for tune_control
```

## src/systemcmds/uorb/Kconfig
```kconfig
menuconfig SYSTEMCMDS_UORB
	bool "uorb"
	default n
	---help---
		Enable support for uorb
```

## src/systemcmds/usb_connected/Kconfig
```kconfig
menuconfig SYSTEMCMDS_USB_CONNECTED
	bool "usb_connected"
	default n
	---help---
		Enable support for usb_connected
```

## src/systemcmds/ver/Kconfig
```kconfig
menuconfig SYSTEMCMDS_VER
	bool "ver"
	default n
	---help---
		Enable support for ver
```

## src/systemcmds/work_queue/Kconfig
```kconfig
menuconfig SYSTEMCMDS_WORK_QUEUE
	bool "work_queue"
	default n
	---help---
		Enable support for work_queue
```
