## src/drivers/barometer/bmp388/Kconfig
```kconfig
menuconfig DRIVERS_BAROMETER_BMP388
	bool "bmp388"
	default n
	---help---
		Enable support for bmp388
```

## src/drivers/barometer/dps310/Kconfig
```kconfig
menuconfig DRIVERS_BAROMETER_DPS310
	bool "dps310"
	default n
	---help---
		Enable support for dps310
```

## src/drivers/barometer/lps22hb/Kconfig
```kconfig
menuconfig DRIVERS_BAROMETER_LPS22HB
	bool "lps22hb"
	default n
	---help---
		Enable support for lps22hb
```

## src/drivers/barometer/lps25h/Kconfig
```kconfig
menuconfig DRIVERS_BAROMETER_LPS25H
	bool "lps25h"
	default n
	---help---
		Enable support for lps25h
```

## src/drivers/barometer/lps33hw/Kconfig
```kconfig
menuconfig DRIVERS_BAROMETER_LPS33HW
	bool "lps33hw"
	default n
	---help---
		Enable support for lps33hw
```

## src/drivers/barometer/mpl3115a2/Kconfig
```kconfig
menuconfig DRIVERS_BAROMETER_MPL3115A2
	bool "mpl3115a2"
	default n
	---help---
		Enable support for mpl3115a2
```

## src/drivers/barometer/ms5611/Kconfig
```kconfig
menuconfig DRIVERS_BAROMETER_MS5611
	bool "ms5611"
	default n
	---help---
		Enable support for ms5611
```

## src/drivers/barometer/tcbp001ta/Kconfig
```kconfig
menuconfig DRIVERS_BAROMETER_TCBP001TA
	bool "tcbp001ta"
	default n
	---help---
		Enable support for tcbp001ta
```

## src/drivers/batt_smbus/Kconfig
```kconfig
menuconfig DRIVERS_BATT_SMBUS
	bool "batt_smbus"
	default n
	---help---
		Enable support for batt_smbus
```

## src/drivers/bootloaders/Kconfig
```kconfig
menuconfig DRIVERS_BOOTLOADERS
	bool "bootloaders"
	default n
	---help---
		Enable support for bootloaders
```

## src/drivers/camera_capture/Kconfig
```kconfig
menuconfig DRIVERS_CAMERA_CAPTURE
	bool "camera_capture"
	default n
	---help---
		Enable support for camera_capture
```

## src/drivers/camera_trigger/Kconfig
```kconfig
menuconfig DRIVERS_CAMERA_TRIGGER
	bool "camera_trigger"
	default n
	---help---
		Enable support for camera_trigger
```

## src/drivers/differential_pressure/Kconfig
```kconfig
menuconfig DRIVERS_DIFFERENTIAL_PRESSURE
	bool "differential_pressure"
	default n
	---help---
		Enable support for differential_pressure
```

## src/drivers/differential_pressure/ets/Kconfig
```kconfig
menuconfig DRIVERS_DIFFERENTIAL_PRESSURE_ETS
	bool "ets"
	default n
	---help---
		Enable support for ets
```

## src/drivers/differential_pressure/ms4525/Kconfig
```kconfig
menuconfig DRIVERS_DIFFERENTIAL_PRESSURE_MS4525
	bool "ms4525"
	default n
	---help---
		Enable support for ms4525
```

## src/drivers/differential_pressure/ms5525/Kconfig
```kconfig
menuconfig DRIVERS_DIFFERENTIAL_PRESSURE_MS5525
	bool "ms5525"
	default n
	---help---
		Enable support for ms5525
```

## src/drivers/differential_pressure/sdp3x/Kconfig
```kconfig
menuconfig DRIVERS_DIFFERENTIAL_PRESSURE_SDP3X
	bool "sdp3x"
	default n
	---help---
		Enable support for sdp3x
```

## src/drivers/distance_sensor/Kconfig
```kconfig
menuconfig DRIVERS_DISTANCE_SENSOR
	bool "distance_sensor"
	default n
	---help---
		Enable support for distance_sensor
		
if DRIVERS_DISTANCE_SENSOR
rsource "*/Kconfig"
endif #DRIVERS_DISTANCE_SENSOR
```

## src/drivers/distance_sensor/cm8jl65/Kconfig
```kconfig
menuconfig DRIVERS_DISTANCE_SENSOR_CM8JL65
	bool "cm8jl65"
	default n
	---help---
		Enable support for cm8jl65
```

## src/drivers/distance_sensor/leddar_one/Kconfig
```kconfig
menuconfig DRIVERS_DISTANCE_SENSOR_LEDDAR_ONE
	bool "leddar_one"
	default n
	---help---
		Enable support for leddar_one
```

## src/drivers/distance_sensor/lightware_laser_i2c/Kconfig
```kconfig
menuconfig DRIVERS_DISTANCE_SENSOR_LIGHTWARE_LASER_I2C
	bool "lightware_laser_i2c"
	default n
	---help---
		Enable support for lightware_laser_i2c
```

## src/drivers/distance_sensor/lightware_laser_serial/Kconfig
```kconfig
menuconfig DRIVERS_DISTANCE_SENSOR_LIGHTWARE_LASER_SERIAL
	bool "lightware_laser_serial"
	default n
	---help---
		Enable support for lightware_laser_serial
```

## src/drivers/distance_sensor/ll40ls/Kconfig
```kconfig
menuconfig DRIVERS_DISTANCE_SENSOR_LL40LS
	bool "ll40ls"
	default n
	---help---
		Enable support for ll40ls
```

## src/drivers/distance_sensor/ll40ls_pwm/Kconfig
```kconfig
menuconfig DRIVERS_DISTANCE_SENSOR_LL40LS_PWM
	bool "ll40ls_pwm"
	default n
	---help---
		Enable support for ll40ls_pwm
```

## src/drivers/distance_sensor/mappydot/Kconfig
```kconfig
menuconfig DRIVERS_DISTANCE_SENSOR_MAPPYDOT
	bool "mappydot"
	default n
	---help---
		Enable support for mappydot
```
