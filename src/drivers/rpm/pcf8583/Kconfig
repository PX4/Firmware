## src/drivers/rpm/pcf8583/Kconfig
```kconfig
menuconfig DRIVERS_RPM_PCF8583
	bool "pcf8583"
	default n
	---help---
		Enable support for pcf8583
```

## src/drivers/rpm/rpm_simulator/Kconfig
```kconfig
menuconfig DRIVERS_RPM_RPM_SIMULATOR
	bool "rpm_simulator"
	default n
	---help---
		Enable support for rpm_simulator
```

## src/drivers/safety_button/Kconfig
```kconfig
menuconfig DRIVERS_SAFETY_BUTTON
	bool "safety_button"
	default n
	---help---
		Enable support for safety_button
```

## src/drivers/smart_battery/batmon/Kconfig
```kconfig
menuconfig DRIVERS_SMART_BATTERY_BATMON
	bool "batmon"
	default n
	---help---
		Enable support for batmon
```

## src/drivers/spektrum_rc/Kconfig
```kconfig
menuconfig DRIVERS_SPEKTRUM_RC
	bool "spektrum_rc"
	default n
	---help---
		Enable support for spektrum_rc
```

## src/drivers/telemetry/Kconfig
```kconfig
menuconfig DRIVERS_TELEMETRY
	bool "telemetry"
	default n
	---help---
		Enable support for telemetry
```

## src/drivers/telemetry/bst/Kconfig
```kconfig
menuconfig DRIVERS_TELEMETRY_BST
	bool "bst"
	default n
	---help---
		Enable support for bst
```

## src/drivers/telemetry/frsky_telemetry/Kconfig
```kconfig
menuconfig DRIVERS_TELEMETRY_FRSKY_TELEMETRY
	bool "frsky_telemetry"
	default n
	---help---
		Enable support for frsky_telemetry
```

## src/drivers/telemetry/hott/Kconfig
```kconfig
menuconfig DRIVERS_TELEMETRY_HOTT
	bool "hott"
	default n
	---help---
		Enable support for hott
```

## src/drivers/telemetry/iridiumsbd/Kconfig
```kconfig
menuconfig DRIVERS_TELEMETRY_IRIDIUMSBD
	bool "iridiumsbd"
	default n
	---help---
		Enable support for iridiumsbd
```

## src/drivers/test_ppm/Kconfig
```kconfig
menuconfig DRIVERS_TEST_PPM
	bool "test_ppm"
	default n
	---help---
		Enable support for test_ppm
```

## src/drivers/tone_alarm/Kconfig
```kconfig
menuconfig DRIVERS_TONE_ALARM
	bool "tone_alarm"
	default n
	---help---
		Enable support for tone_alarm
```

## src/drivers/uavcan/Kconfig
```kconfig
menuconfig DRIVERS_UAVCAN
	bool "uavcan"
	default n
	---help---
		Enable support for uavcan

if DRIVERS_UAVCAN
    menuconfig UAVCAN_INTERFACES
        int "UAVCANv0 interface count"
        default 0
        ---help---
            Interface count for UAVCANv0
endif #DRIVERS_UAVCAN
```

## src/drivers/uavcan_v1/Kconfig
```kconfig
#
# For a description of the syntax of this configuration file,
# see the file kconfig-language.txt in the NuttX tools repository.
#
menuconfig DRIVERS_UAVCAN_V1
	bool "UAVCANv1"
	default n
	---help---
		Enable support for UAVCANv1

if DRIVERS_UAVCAN_V1
    choice
        prompt "UAVCANv1 Mode"

    config UAVCAN_V1_FMU
        bool "Server (FMU)"

    config UAVCAN_V1_CLIENT
        bool "Client (Peripheral)"

    endchoice

    config UAVCAN_V1_GETINFO_RESPONDER
        bool "GetInfo1.0 responder"
        default n

    config UAVCAN_V1_EXECUTECOMMAND_RESPONDER
        bool "ExecuteCommand1.0 responder"
        default n

    config UAVCAN_V1_GNSS_PUBLISHER
        bool "GNSS Publisher"
        default n
endif #DRIVERS_UAVCAN_V1
```

## src/drivers/uavcannode/Kconfig
```kconfig
menuconfig DRIVERS_UAVCANNODE
	bool "uavcannode"
	default n
	---help---
		Enable support for uavcannode
```

## src/drivers/uavcannode_gps_demo/Kconfig
```kconfig
menuconfig DRIVERS_UAVCANNODE_GPS_DEMO
	bool "uavcannode_gps_demo"
	default n
	---help---
		Enable support for uavcannode_gps_demo
```

## src/examples/Kconfig
```kconfig
menuconfig EXAMPLES_DYN_HELLO
	bool "dyn hello"
	default n
	---help---
		Enable support for dyn hello
		
menuconfig EXAMPLES_FAKE_GPS
	bool "fake gps"
	default n
	---help---
		Enable support for fake gps
		
menuconfig EXAMPLES_FAKE_GYRO
	bool "fake gyro"
	default n
	---help---
		Enable support for fake gyro
		
menuconfig EXAMPLES_FAKE_MAGNETOMETER
	bool "fake magnetometer"
	default n
	---help---
		Enable support for fake magnetometer
		
menuconfig EXAMPLES_FIXEDWING_CONTROL
	bool "fixedwing control"
	default n
	---help---
		Enable support for fixedwing control
		
menuconfig EXAMPLES_HELLO
	bool "hello"
	default n
	---help---
		Enable support for hello
		
menuconfig EXAMPLES_HWTEST
	bool "hwtest"
	default n
	---help---
		Enable support for hwtest
		
menuconfig EXAMPLES_MATLAB_CSV_SERIAL
	bool "matlab csv serial"
	default n
	---help---
		Enable support for matlab csv serial
		
menuconfig EXAMPLES_PX4_MAVLINK_DEBUG
	bool "px4 mavlink debug"
	default n
	---help---
		Enable support for px4 mavlink debug
		
menuconfig EXAMPLES_PX4_SIMPLE_APP
	bool "px4 simple app"
	default n
	---help---
		Enable support for px4 simple app
		
menuconfig EXAMPLES_ROVER_STEERING_CONTROL
	bool "rover steering control"
	default n
	---help---
		Enable support for rover steering control
		
menuconfig EXAMPLES_UUV_EXAMPLE_APP
	bool "uuv example app"
	default n
	---help---
		Enable support for uuv example app
		
menuconfig EXAMPLES_WORK_ITEM
	bool "work item"
	default n
	---help---
		Enable support for work item
```

## src/examples/dyn_hello/Kconfig
```kconfig
menuconfig EXAMPLES_DYN_HELLO
	bool "dyn_hello"
	default n
	---help---
		Enable support for dyn_hello
```

## src/examples/fake_gps/Kconfig
```kconfig
menuconfig EXAMPLES_FAKE_GPS
	bool "fake_gps"
	default n
	---help---
		Enable support for fake_gps
```

## src/examples/fake_gyro/Kconfig
```kconfig
menuconfig EXAMPLES_FAKE_GYRO
	bool "fake_gyro"
	default n
	---help---
		Enable support for fake_gyro
```

## src/examples/fake_magnetometer/Kconfig
```kconfig
menuconfig EXAMPLES_FAKE_MAGNETOMETER
	bool "fake_magnetometer"
	default n
	---help---
		Enable support for fake_magnetometer
```

## src/examples/fixedwing_control/Kconfig
```kconfig
menuconfig EXAMPLES_FIXEDWING_CONTROL
	bool "fixedwing_control"
	default n
	---help---
		Enable support for fixedwing_control
```

## src/examples/hello/Kconfig
```kconfig
menuconfig EXAMPLES_HELLO
	bool "hello"
	default n
	---help---
		Enable support for hello
```

## src/examples/hwtest/Kconfig
```kconfig
menuconfig EXAMPLES_HWTEST
	bool "hwtest"
	default n
	---help---
		Enable support for hwtest
```
