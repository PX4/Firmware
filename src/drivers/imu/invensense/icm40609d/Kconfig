## src/drivers/imu/invensense/icm40609d/Kconfig
```kconfig
menuconfig DRIVERS_IMU_INVENSENSE_ICM40609D
	bool "icm40609d"
	default n
	---help---
		Enable support for icm40609d
```

## src/drivers/imu/invensense/icm42605/Kconfig
```kconfig
menuconfig DRIVERS_IMU_INVENSENSE_ICM42605
	bool "icm42605"
	default n
	---help---
		Enable support for icm42605
```

## src/drivers/imu/invensense/icm42688p/Kconfig
```kconfig
menuconfig DRIVERS_IMU_INVENSENSE_ICM42688P
	bool "icm42688p"
	default n
	---help---
		Enable support for icm42688p
```

## src/drivers/imu/invensense/mpu6000/Kconfig
```kconfig
menuconfig DRIVERS_IMU_INVENSENSE_MPU6000
	bool "mpu6000"
	default n
	---help---
		Enable support for mpu6000
```

## src/drivers/imu/invensense/mpu6500/Kconfig
```kconfig
menuconfig DRIVERS_IMU_INVENSENSE_MPU6500
	bool "mpu6500"
	default n
	---help---
		Enable support for mpu6500
```

## src/drivers/imu/invensense/mpu9250/Kconfig
```kconfig
menuconfig DRIVERS_IMU_INVENSENSE_MPU9250
	bool "mpu9250"
	default n
	---help---
		Enable support for mpu9250
```

## src/drivers/imu/l3gd20/Kconfig
```kconfig
menuconfig DRIVERS_IMU_L3GD20
	bool "l3gd20"
	default n
	---help---
		Enable support for l3gd20
```

## src/drivers/imu/lsm303d/Kconfig
```kconfig
menuconfig DRIVERS_IMU_LSM303D
	bool "lsm303d"
	default n
	---help---
		Enable support for lsm303d
```

## src/drivers/imu/st/Kconfig
```kconfig
menuconfig DRIVERS_IMU_ST
	bool "st"
	default n
	---help---
		Enable support for st
```

## src/drivers/irlock/Kconfig
```kconfig
menuconfig DRIVERS_IRLOCK
	bool "irlock"
	default n
	---help---
		Enable support for irlock
```

## src/drivers/lights/neopixel/Kconfig
```kconfig
menuconfig DRIVERS_LIGHTS_NEOPIXEL
	bool "neopixel"
	default n
	---help---
		Enable support for neopixel
```

## src/drivers/lights/rgbled/Kconfig
```kconfig
menuconfig DRIVERS_LIGHTS_RGBLED
	bool "rgbled"
	default n
	---help---
		Enable support for rgbled
```

## src/drivers/lights/rgbled_ncp5623c/Kconfig
```kconfig
menuconfig DRIVERS_LIGHTS_RGBLED_NCP5623C
	bool "rgbled_ncp5623c"
	default n
	---help---
		Enable support for rgbled_ncp5623c
```

## src/drivers/lights/rgbled_pwm/Kconfig
```kconfig
menuconfig DRIVERS_LIGHTS_RGBLED_PWM
	bool "rgbled_pwm"
	default n
	---help---
		Enable support for rgbled_pwm
```

## src/drivers/linux_pwm_out/Kconfig
```kconfig
menuconfig DRIVERS_LINUX_PWM_OUT
	bool "linux_pwm_out"
	default n
	---help---
		Enable support for linux_pwm_out
```

## src/drivers/magnetometer/Kconfig
```kconfig
menuconfig DRIVERS_MAGNETOMETER
	bool "Magnetometer"
	default n
	---help---
		Enable support for all available magnetometer drivers
		
if DRIVERS_MAGNETOMETER
rsource "*/Kconfig"
endif #DRIVERS_MAGNETOMETER
```

## src/drivers/magnetometer/akm/Kconfig
```kconfig
menuconfig DRIVERS_MAGNETOMETER_AKM
	bool "akm"
	default n
	---help---
		Enable support for akm
```

## src/drivers/magnetometer/bosch/Kconfig
```kconfig
menuconfig DRIVERS_MAGNETOMETER_BOSCH
	bool "bosch"
	default n
	---help---
		Enable support for bosch
```

## src/drivers/magnetometer/hmc5883/Kconfig
```kconfig
menuconfig DRIVERS_MAGNETOMETER_HMC5883
	bool "hmc5883"
	default n
	---help---
		Enable support for hmc5883
```

## src/drivers/magnetometer/isentek/Kconfig
```kconfig
menuconfig DRIVERS_MAGNETOMETER_ISENTEK
	bool "isentek"
	default n
	---help---
		Enable support for isentek
```

## src/drivers/magnetometer/lis2mdl/Kconfig
```kconfig
menuconfig DRIVERS_MAGNETOMETER_LIS2MDL
	bool "lis2mdl"
	default n
	---help---
		Enable support for lis2mdl
```

## src/drivers/magnetometer/lis3mdl/Kconfig
```kconfig
menuconfig DRIVERS_MAGNETOMETER_LIS3MDL
	bool "lis3mdl"
	default n
	---help---
		Enable support for lis3mdl
```

## src/drivers/magnetometer/lsm303agr/Kconfig
```kconfig
menuconfig DRIVERS_MAGNETOMETER_LSM303AGR
	bool "lsm303agr"
	default n
	---help---
		Enable support for lsm303agr
```

## src/drivers/magnetometer/lsm9ds1_mag/Kconfig
```kconfig
menuconfig DRIVERS_MAGNETOMETER_LSM9DS1_MAG
	bool "lsm9ds1_mag"
	default n
	---help---
		Enable support for lsm9ds1_mag
```
