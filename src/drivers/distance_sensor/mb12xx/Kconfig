## src/drivers/distance_sensor/mb12xx/Kconfig
```kconfig
menuconfig DRIVERS_DISTANCE_SENSOR_MB12XX
	bool "mb12xx"
	default n
	---help---
		Enable support for mb12xx
```

## src/drivers/distance_sensor/pga460/Kconfig
```kconfig
menuconfig DRIVERS_DISTANCE_SENSOR_PGA460
	bool "pga460"
	default n
	---help---
		Enable support for pga460
```

## src/drivers/distance_sensor/srf02/Kconfig
```kconfig
menuconfig DRIVERS_DISTANCE_SENSOR_SRF02
	bool "srf02"
	default n
	---help---
		Enable support for srf02
```

## src/drivers/distance_sensor/srf05/Kconfig
```kconfig
menuconfig DRIVERS_DISTANCE_SENSOR_SRF05
	bool "srf05"
	default n
	---help---
		Enable support for srf05
```

## src/drivers/distance_sensor/teraranger/Kconfig
```kconfig
menuconfig DRIVERS_DISTANCE_SENSOR_TERARANGER
	bool "teraranger"
	default n
	---help---
		Enable support for teraranger
```

## src/drivers/distance_sensor/tfmini/Kconfig
```kconfig
menuconfig DRIVERS_DISTANCE_SENSOR_TFMINI
	bool "tfmini"
	default n
	---help---
		Enable support for tfmini
```

## src/drivers/distance_sensor/ulanding_radar/Kconfig
```kconfig
menuconfig DRIVERS_DISTANCE_SENSOR_ULANDING_RADAR
	bool "ulanding_radar"
	default n
	---help---
		Enable support for ulanding_radar
```

## src/drivers/distance_sensor/vl53l0x/Kconfig
```kconfig
menuconfig DRIVERS_DISTANCE_SENSOR_VL53L0X
	bool "vl53l0x"
	default n
	---help---
		Enable support for vl53l0x
```

## src/drivers/distance_sensor/vl53l1x/Kconfig
```kconfig
menuconfig DRIVERS_DISTANCE_SENSOR_VL53L1X
	bool "vl53l1x"
	default n
	---help---
		Enable support for vl53l1x
```

## src/drivers/dshot/Kconfig
```kconfig
menuconfig DRIVERS_DSHOT
	bool "dshot"
	default n
	---help---
		Enable support for dshot
```

## src/drivers/gps/Kconfig
```kconfig
menuconfig DRIVERS_GPS
	bool "gps"
	default n
	---help---
		Enable support for gps
```

## src/drivers/heater/Kconfig
```kconfig
menuconfig DRIVERS_HEATER
	bool "heater"
	default n
	---help---
		Enable support for heater
```

## src/drivers/imu/adis16477/Kconfig
```kconfig
menuconfig DRIVERS_IMU_ADIS16477
	bool "adis16477"
	default n
	---help---
		Enable support for adis16477
```

## src/drivers/imu/adis16497/Kconfig
```kconfig
menuconfig DRIVERS_IMU_ADIS16497
	bool "adis16497"
	default n
	---help---
		Enable support for adis16497
```

## src/drivers/imu/analog_devices/Kconfig
```kconfig
menuconfig DRIVERS_IMU_ANALOG_DEVICES
	bool "analog_devices"
	default n
	---help---
		Enable support for analog_devices
```

## src/drivers/imu/bosch/Kconfig
```kconfig
menuconfig DRIVERS_IMU_BOSCH
	bool "bosch"
	default n
	---help---
		Enable support for bosch
```

## src/drivers/imu/fxas21002c/Kconfig
```kconfig
menuconfig DRIVERS_IMU_FXAS21002C
	bool "fxas21002c"
	default n
	---help---
		Enable support for fxas21002c
```

## src/drivers/imu/fxos8701cq/Kconfig
```kconfig
menuconfig DRIVERS_IMU_FXOS8701CQ
	bool "fxos8701cq"
	default n
	---help---
		Enable support for fxos8701cq
```

## src/drivers/imu/invensense/icm20602/Kconfig
```kconfig
menuconfig DRIVERS_IMU_INVENSENSE_ICM20602
	bool "icm20602"
	default n
	---help---
		Enable support for icm20602
```

## src/drivers/imu/invensense/icm20608g/Kconfig
```kconfig
menuconfig DRIVERS_IMU_INVENSENSE_ICM20608G
	bool "icm20608g"
	default n
	---help---
		Enable support for icm20608g
```

## src/drivers/imu/invensense/icm20649/Kconfig
```kconfig
menuconfig DRIVERS_IMU_INVENSENSE_ICM20649
	bool "icm20649"
	default n
	---help---
		Enable support for icm20649
```

## src/drivers/imu/invensense/icm20689/Kconfig
```kconfig
menuconfig DRIVERS_IMU_INVENSENSE_ICM20689
	bool "icm20689"
	default n
	---help---
		Enable support for icm20689
```

## src/drivers/imu/invensense/icm20948/Kconfig
```kconfig
menuconfig DRIVERS_IMU_INVENSENSE_ICM20948
	bool "icm20948"
	default n
	---help---
		Enable support for icm20948
```
