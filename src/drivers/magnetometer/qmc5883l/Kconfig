## src/drivers/magnetometer/qmc5883l/Kconfig
```kconfig
menuconfig DRIVERS_MAGNETOMETER_QMC5883L
	bool "qmc5883l"
	default n
	---help---
		Enable support for qmc5883l
```

## src/drivers/magnetometer/rm3100/Kconfig
```kconfig
menuconfig DRIVERS_MAGNETOMETER_RM3100
	bool "rm3100"
	default n
	---help---
		Enable support for rm3100
```

## src/drivers/optical_flow/paw3902/Kconfig
```kconfig
menuconfig DRIVERS_OPTICAL_FLOW_PAW3902
	bool "paw3902"
	default n
	---help---
		Enable support for paw3902
```

## src/drivers/optical_flow/pmw3901/Kconfig
```kconfig
menuconfig DRIVERS_OPTICAL_FLOW_PMW3901
	bool "pmw3901"
	default n
	---help---
		Enable support for pmw3901
```

## src/drivers/optical_flow/px4flow/Kconfig
```kconfig
menuconfig DRIVERS_OPTICAL_FLOW_PX4FLOW
	bool "px4flow"
	default n
	---help---
		Enable support for px4flow
```

## src/drivers/optical_flow/thoneflow/Kconfig
```kconfig
menuconfig DRIVERS_OPTICAL_FLOW_THONEFLOW
	bool "thoneflow"
	default n
	---help---
		Enable support for thoneflow
```

## src/drivers/osd/Kconfig
```kconfig
menuconfig DRIVERS_OSD
	bool "osd"
	default n
	---help---
		Enable support for osd
```

## src/drivers/osd/atxxxx/Kconfig
```kconfig
menuconfig DRIVERS_OSD_ATXXXX
	bool "atxxxx"
	default n
	---help---
		Enable support for atxxxx
```

## src/drivers/pca9685/Kconfig
```kconfig
menuconfig DRIVERS_PCA9685
	bool "pca9685"
	default n
	---help---
		Enable support for pca9685
```

## src/drivers/pca9685_pwm_out/Kconfig
```kconfig
menuconfig DRIVERS_PCA9685_PWM_OUT
	bool "pca9685_pwm_out"
	default n
	---help---
		Enable support for pca9685_pwm_out
```

## src/drivers/power_monitor/ina226/Kconfig
```kconfig
menuconfig DRIVERS_POWER_MONITOR_INA226
	bool "ina226"
	default n
	---help---
		Enable support for ina226
```

## src/drivers/power_monitor/voxlpm/Kconfig
```kconfig
menuconfig DRIVERS_POWER_MONITOR_VOXLPM
	bool "voxlpm"
	default n
	---help---
		Enable support for voxlpm
```

## src/drivers/protocol_splitter/Kconfig
```kconfig
menuconfig DRIVERS_PROTOCOL_SPLITTER
	bool "protocol_splitter"
	default n
	---help---
		Enable support for protocol_splitter
```

## src/drivers/pwm_input/Kconfig
```kconfig
menuconfig DRIVERS_PWM_INPUT
	bool "pwm_input"
	default n
	---help---
		Enable support for pwm_input
```

## src/drivers/pwm_out/Kconfig
```kconfig
menuconfig DRIVERS_PWM_OUT
	bool "pwm_out"
	default n
	---help---
		Enable support for pwm_out
```

## src/drivers/pwm_out_sim/Kconfig
```kconfig
menuconfig DRIVERS_PWM_OUT_SIM
	bool "pwm_out_sim"
	default n
	---help---
		Enable support for pwm_out_sim
```

## src/drivers/px4io/Kconfig
```kconfig
menuconfig DRIVERS_PX4IO
	bool "px4io"
	default n
	---help---
		Enable support for px4io
```

## src/drivers/qshell/posix/Kconfig
```kconfig
menuconfig DRIVERS_QSHELL_POSIX
	bool "posix"
	default n
	---help---
		Enable support for posix
```

## src/drivers/qshell/qurt/Kconfig
```kconfig
menuconfig DRIVERS_QSHELL_QURT
	bool "qurt"
	default n
	---help---
		Enable support for qurt
```

## src/drivers/rc_input/Kconfig
```kconfig
menuconfig DRIVERS_RC_INPUT
	bool "rc_input"
	default n
	---help---
		Enable support for rc_input
```

## src/drivers/roboclaw/Kconfig
```kconfig
menuconfig DRIVERS_ROBOCLAW
	bool "roboclaw"
	default n
	---help---
		Enable support for roboclaw
```

## src/drivers/rpi_rc_in/Kconfig
```kconfig
menuconfig DRIVERS_RPI_RC_IN
	bool "rpi_rc_in"
	default n
	---help---
		Enable support for rpi_rc_in
```

## src/drivers/rpm/Kconfig
```kconfig
menuconfig DRIVERS_RPM
	bool "rpm"
	default n
	---help---
		Enable support for rpm
```
