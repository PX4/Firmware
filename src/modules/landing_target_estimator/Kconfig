## src/modules/landing_target_estimator/Kconfig
```kconfig
menuconfig MODULES_LANDING_TARGET_ESTIMATOR
	bool "landing_target_estimator"
	default n
	---help---
		Enable support for landing_target_estimator
```

## src/modules/load_mon/Kconfig
```kconfig
menuconfig MODULES_LOAD_MON
	bool "load_mon"
	default n
	---help---
		Enable support for load_mon
```

## src/modules/local_position_estimator/Kconfig
```kconfig
menuconfig MODULES_LOCAL_POSITION_ESTIMATOR
	bool "local_position_estimator"
	default n
	---help---
		Enable support for local_position_estimator
```

## src/modules/logger/Kconfig
```kconfig
menuconfig MODULES_LOGGER
	bool "logger"
	default n
	---help---
		Enable support for logger
```

## src/modules/mavlink/Kconfig
```kconfig
menuconfig MODULES_MAVLINK
	bool "mavlink"
	default n
	---help---
		Enable support for mavlink
```

## src/modules/mc_att_control/Kconfig
```kconfig
menuconfig MODULES_MC_ATT_CONTROL
	bool "mc_att_control"
	default n
	---help---
		Enable support for mc_att_control
```

## src/modules/mc_hover_thrust_estimator/Kconfig
```kconfig
menuconfig MODULES_MC_HOVER_THRUST_ESTIMATOR
	bool "mc_hover_thrust_estimator"
	default n
	---help---
		Enable support for mc_hover_thrust_estimator
```

## src/modules/mc_pos_control/Kconfig
```kconfig
menuconfig MODULES_MC_POS_CONTROL
	bool "mc_pos_control"
	default n
	---help---
		Enable support for mc_pos_control
```

## src/modules/mc_rate_control/Kconfig
```kconfig
menuconfig MODULES_MC_RATE_CONTROL
	bool "mc_rate_control"
	default n
	---help---
		Enable support for mc_rate_control
```

## src/modules/micrortps_bridge/Kconfig
```kconfig
menuconfig MODULES_MICRORTPS_BRIDGE
	bool "micrortps_bridge"
	default n
	---help---
		Enable support for micrortps_bridge
```

## src/modules/navigator/Kconfig
```kconfig
menuconfig MODULES_NAVIGATOR
	bool "navigator"
	default n
	---help---
		Enable support for navigator
```

## src/modules/px4iofirmware/Kconfig
```kconfig
menuconfig MODULES_PX4IOFIRMWARE
	bool "px4iofirmware"
	default n
	---help---
		Enable support for px4iofirmware
```

## src/modules/rc_update/Kconfig
```kconfig
menuconfig MODULES_RC_UPDATE
	bool "rc_update"
	default n
	---help---
		Enable support for rc_update
```

## src/modules/replay/Kconfig
```kconfig
menuconfig MODULES_REPLAY
	bool "replay"
	default n
	---help---
		Enable support for replay
```

## src/modules/rover_pos_control/Kconfig
```kconfig
menuconfig MODULES_ROVER_POS_CONTROL
	bool "rover_pos_control"
	default n
	---help---
		Enable support for rover_pos_control
```

## src/modules/sensors/Kconfig
```kconfig
menuconfig MODULES_SENSORS
	bool "sensors"
	default n
	---help---
		Enable support for sensors
```

## src/modules/sih/Kconfig
```kconfig
menuconfig MODULES_SIH
	bool "sih"
	default n
	---help---
		Enable support for sih
```

## src/modules/simulator/Kconfig
```kconfig
menuconfig MODULES_SIMULATOR
	bool "simulator"
	default n
	---help---
		Enable support for simulator
```

## src/modules/temperature_compensation/Kconfig
```kconfig
menuconfig MODULES_TEMPERATURE_COMPENSATION
	bool "temperature_compensation"
	default n
	---help---
		Enable support for temperature_compensation
```

## src/modules/uuv_att_control/Kconfig
```kconfig
menuconfig MODULES_UUV_ATT_CONTROL
	bool "uuv_att_control"
	default n
	---help---
		Enable support for uuv_att_control
```

## src/modules/uuv_pos_control/Kconfig
```kconfig
menuconfig MODULES_UUV_POS_CONTROL
	bool "uuv_pos_control"
	default n
	---help---
		Enable support for uuv_pos_control
```

## src/modules/vmount/Kconfig
```kconfig
menuconfig MODULES_VMOUNT
	bool "vmount"
	default n
	---help---
		Enable support for vmount
```

## src/modules/vtol_att_control/Kconfig
```kconfig
menuconfig MODULES_VTOL_ATT_CONTROL
	bool "vtol_att_control"
	default n
	---help---
		Enable support for vtol_att_control
```

## src/systemcmds/Kconfig
```kconfig
menuconfig SYSTEMCMDS_BL_UPDATE
	bool "bl update"
	default n
	---help---
		Enable support for bl update
		
menuconfig SYSTEMCMDS_DMESG
	bool "dmesg"
	default n
	---help---
		Enable support for dmesg
		
menuconfig SYSTEMCMDS_DUMPFILE
	bool "dumpfile"
	default n
	---help---
		Enable support for dumpfile
		
menuconfig SYSTEMCMDS_DYN
	bool "dyn"
	default n
	---help---
		Enable support for dyn
		
menuconfig SYSTEMCMDS_ESC_CALIB
	bool "esc calib"
	default n
	---help---
		Enable support for esc calib
		
menuconfig SYSTEMCMDS_FAILURE
	bool "failure"
	default n
	---help---
		Enable support for failure
		
menuconfig SYSTEMCMDS_GPIO
	bool "gpio"
	default n
	---help---
		Enable support for gpio
		
menuconfig SYSTEMCMDS_HARDFAULT_LOG
	bool "hardfault log"
	default n
	---help---
		Enable support for hardfault log
		
menuconfig SYSTEMCMDS_I2CDETECT
	bool "i2cdetect"
	default n
	---help---
		Enable support for i2cdetect
		
menuconfig SYSTEMCMDS_LED_CONTROL
	bool "led control"
	default n
	---help---
		Enable support for led control
		
menuconfig SYSTEMCMDS_MFT
	bool "mft"
	default n
	---help---
		Enable support for mft
		
menuconfig SYSTEMCMDS_MIXER
	bool "mixer"
	default n
	---help---
		Enable support for mixer
		
menuconfig SYSTEMCMDS_MOTOR_RAMP
	bool "motor ramp"
	default n
	---help---
		Enable support for motor ramp
		
menuconfig SYSTEMCMDS_MOTOR_TEST
	bool "motor test"
	default n
	---help---
		Enable support for motor test
		
menuconfig SYSTEMCMDS_MTD
	bool "mtd"
	default n
	---help---
		Enable support for mtd
		
menuconfig SYSTEMCMDS_NETMAN
	bool "netman"
	default n
	---help---
		Enable support for netman
		
menuconfig SYSTEMCMDS_NSHTERM
	bool "nshterm"
	default n
	---help---
		Enable support for nshterm
		
menuconfig SYSTEMCMDS_PARAM
	bool "param"
	default n
	---help---
		Enable support for param
		
menuconfig SYSTEMCMDS_PERF
	bool "perf"
	default n
	---help---
		Enable support for perf
		
menuconfig SYSTEMCMDS_PWM
	bool "pwm"
	default n
	---help---
		Enable support for pwm
		
menuconfig SYSTEMCMDS_REBOOT
	bool "reboot"
	default n
	---help---
		Enable support for reboot
		
menuconfig SYSTEMCMDS_REFLECT
	bool "reflect"
	default n
	---help---
		Enable support for reflect
		
menuconfig SYSTEMCMDS_SD_BENCH
	bool "sd bench"
	default n
	---help---
		Enable support for sd bench
		
menuconfig SYSTEMCMDS_SERIAL_TEST
	bool "serial test"
	default n
	---help---
		Enable support for serial test
		
menuconfig SYSTEMCMDS_SHUTDOWN
	bool "shutdown"
	default n
	---help---
		Enable support for shutdown
		
menuconfig SYSTEMCMDS_SYSTEM_TIME
	bool "system time"
	default n
	---help---
		Enable support for system time
		
menuconfig SYSTEMCMDS_TESTS
	bool "tests"
	default n
	---help---
		Enable support for tests
		
menuconfig SYSTEMCMDS_TOP
	bool "top"
	default n
	---help---
		Enable support for top
		
menuconfig SYSTEMCMDS_TOPIC_LISTENER
	bool "topic listener"
	default n
	---help---
		Enable support for topic listener
		
menuconfig SYSTEMCMDS_TUNE_CONTROL
	bool "tune control"
	default n
	---help---
		Enable support for tune control
		
menuconfig SYSTEMCMDS_UORB
	bool "uorb"
	default n
	---help---
		Enable support for uorb
		
menuconfig SYSTEMCMDS_USB_CONNECTED
	bool "usb connected"
	default n
	---help---
		Enable support for usb connected
		
menuconfig SYSTEMCMDS_VER
	bool "ver"
	default n
	---help---
		Enable support for ver
		
menuconfig SYSTEMCMDS_WORK_QUEUE
	bool "work queue"
	default n
	---help---
		Enable support for work queue
```

## src/systemcmds/bl_update/Kconfig
```kconfig
menuconfig SYSTEMCMDS_BL_UPDATE
	bool "bl_update"
	default n
	---help---
		Enable support for bl_update
```
